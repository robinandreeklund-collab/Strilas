## firmware-esp/sdkconfig.defaults
```kconfig
# STRILAS ESP32-P4-WIFI6 (P4 HP-kärnor + onboard C6 WiFi6). Bänk-bringup justerar.
CONFIG_IDF_TARGET="esp32p4"
CONFIG_SPIRAM=y
CONFIG_FREERTOS_HZ=1000
CONFIG_ESP_TASK_WDT_EN=y
# WiFi6/ESP-NOW via C6-coprocessor (esp_hosted/SDIO) — sätts vid bringup.
```
